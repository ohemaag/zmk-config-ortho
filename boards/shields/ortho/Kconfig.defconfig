## boards/shields/ortho/Kconfig.defconfig
```kconfig
if SHIELD_ORTHO_LEFT

    config ZMK_KEYBOARD_NAME
        default "ortho"

    config ZMK_SPLIT_BLE_ROLE_CENTRAL
        default y

endif

if SHIELD_ORTHO_RIGHT

    config ZMK_KEYBOARD_NAME
        default "ortho"

endif

if SHIELD_ORTHO_LEFT || SHIELD_ORTHO_RIGHT

    config ZMK_SPLIT
        default y

endif
```

## boards/shields/ortho/Kconfig.shield
```kconfig
config SHIELD_ORTHO_LEFT
    def_bool $(shields_list_contains, ortho_left)

config SHIELD_ORTHO_RIGHT
    def_bool $(shields_list_contains, ortho_right)
```

## config/boards/shields/ortho/Kconfig.defconfig
```kconfig
if SHIELD_ORTHOLEFT

    config ZMK_KEYBOARD_NAME
        default "ortho"

    config ZMK_SPLIT_BLE_ROLE_CENTRAL
        default y

endif

if SHIELD_ORTHORIGHT

    config ZMK_KEYBOARD_NAME
        default "ortho"

endif

if SHIELD_ORTHOLEFT || SHIELD_ORTHORIGHT

    config ZMK_SPLIT
        default y

endif
```
