#include "ortho.dtsi"

&kscan0 {
    col-gpios = <&gpio0 4 GPIO_ACTIVE_HIGH>, 
                <&gpio0 5 GPIO_ACTIVE_HIGH>,
                <&gpio1 6 GPIO_ACTIVE_HIGH>,
                <&gpio0 7 GPIO_ACTIVE_HIGH>,
                <&gpio1 8 GPIO_ACTIVE_HIGH>,
                <&gpio1 9 GPIO_ACTIVE_HIGH>;  
};